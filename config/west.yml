## config/west.yml
```yaml
manifest:
  remotes:
    - name: zmkfirmware
      url-base: https://github.com/zmkfirmware
    - name: personal
      url-base: https://github.com/ask-786
  projects:
    - name: zmk
      remote: personal
      revision: feat/individual-hid-battery-reporting
      import: app/west.yml
  self:
    path: config
```
