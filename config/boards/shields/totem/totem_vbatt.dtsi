/*
 * Battery sense configuration for the Totem shield
 */

/ {
    /* This chosen node tells ZMK which device to use for battery readings. */
    chosen {
        zmk,battery = &vbatt;
    };

    vbatt: vbatt {
        compatible = "zmk,battery-voltage-divider";
        label = "BATTERY";
        io-channels = <&adc 7>;
    };
};
